## packages/firmware/main/Kconfig.projbuild
```kconfig
menu "Doudou — Bridge connectivity"

config DOUDOU_WIFI_SSID
    string "Wi-Fi SSID"
    default ""
    help
        Wi-Fi network the device connects to. Leave empty to skip Wi-Fi
        bring-up entirely (firmware still runs the LVGL pet, just without
        Codex events). Set via `idf.py menuconfig` or `sdkconfig.local`.

config DOUDOU_WIFI_PASSWORD
    string "Wi-Fi password"
    default ""
    help
        WPA2 password. Leave empty for open networks.

config DOUDOU_BRIDGE_HOST
    string "Bridge hostname"
    default "doudou-bridge.local"
    help
        mDNS hostname (or static IP). Resolves automatically via mDNS when
        Bridge announces _doudou._tcp.local.

config DOUDOU_BRIDGE_PORT
    int "Bridge WebSocket port"
    default 8788
    range 1 65535

config DOUDOU_PAIRING_TOKEN
    string "Pairing token"
    default "dev-token-change-me"
    help
        Must match Bridge's DOUDOU_PAIRING_TOKEN env var.

config DOUDOU_DEVICE_ID
    string "Device id (reported in hello)"
    default "doudou-esp32-001"

choice DOUDOU_TRANSPORT
    prompt "Bridge transport"
    default DOUDOU_TRANSPORT_WS
    help
        How the firmware talks to Doudou Bridge.
        WS  — Wi-Fi + WebSocket over LAN (mDNS discovery, current default).
        BLE — Bluetooth Low Energy GATT, no Wi-Fi needed; Bridge runs a
              BLE central scanner that finds the device by advertised name.

config DOUDOU_TRANSPORT_WS
    bool "Wi-Fi + WebSocket"

config DOUDOU_TRANSPORT_BLE
    bool "BLE GATT"
    depends on BT_ENABLED && BT_NIMBLE_ENABLED
    help
        Requires NimBLE host. Enable in menuconfig:
            CONFIG_BT_ENABLED=y
            CONFIG_BT_NIMBLE_ENABLED=y
        Or build with the bundled BLE defaults:
            idf.py -DSDKCONFIG_DEFAULTS="sdkconfig.defaults;sdkconfig.defaults.ble" build

endchoice

config DOUDOU_BLE_DEVICE_NAME_PREFIX
    string "BLE advertised name prefix"
    depends on DOUDOU_TRANSPORT_BLE
    default "doudou-"
    help
        Bridge's BLE scanner matches advertisements whose name starts
        with this prefix. The firmware appends the last 6 hex chars of
        its MAC for uniqueness, yielding e.g. "doudou-AABBCC".

config DOUDOU_LCD_FOR_WOKWI
    bool "Build LCD config for Wokwi preview (disable invert + BGR)"
    default n
    help
        Wokwi only models ILI9341 (no GC9A01). Real device uses
        invert-on + BGR pixel order; ILI9341 needs the opposite. This
        flag flips both so the preview shows the intended colours.
        Leave UNSET for real hardware. Enable via
        idf.py -DSDKCONFIG_DEFAULTS="sdkconfig.defaults;sdkconfig.defaults.wokwi".

endmenu
```

## packages/firmware/sdkconfig.defaults
```kconfig
# Doudou ESP-IDF defaults — board: ESP32-2424S012 (ESP32-C3-MINI-1U + GC9A01 round LCD).
# Apply with `idf.py reconfigure`. Override per-developer via sdkconfig.local.

# Target
CONFIG_IDF_TARGET="esp32c3"
CONFIG_IDF_TARGET_ESP32C3=y

# Partition table — use the project-local custom CSV.
CONFIG_PARTITION_TABLE_CUSTOM=y
CONFIG_PARTITION_TABLE_CUSTOM_FILENAME="partitions.csv"

# Flash size (4MB on this board).
CONFIG_ESPTOOLPY_FLASHSIZE_4MB=y
CONFIG_ESPTOOLPY_FLASHSIZE="4MB"
CONFIG_ESPTOOLPY_FLASHMODE_DIO=y
CONFIG_ESPTOOLPY_FLASHFREQ_80M=y

# Tighten heap headroom — LVGL + Wi-Fi will need it later.
CONFIG_FREERTOS_HZ=1000
CONFIG_ESP_MAIN_TASK_STACK_SIZE=4096

# LVGL animation + sprite blitting + 196KB CJK font keeps CPU 0 busy in
# bursts, blocking the IDLE task from petting the watchdog. The system
# isn't actually hung — LVGL keeps yielding via vTaskDelay — but the
# IDLE-task check fires anyway. Disable just that check; the int_wdt
# (interrupt-disabled-too-long) safety remains armed.
# CONFIG_ESP_TASK_WDT_CHECK_IDLE_TASK_CPU0 is not set

# Logging on UART0 — board USB-CDC routes here via the USB-Serial chip.
CONFIG_ESP_CONSOLE_UART_DEFAULT=y
CONFIG_LOG_DEFAULT_LEVEL_INFO=y

# Disable BT for MVP-1a (saves ~50KB RAM, will re-enable for BLE pairing in MVP-3).
# CONFIG_BT_ENABLED is not set

# ---- LWIP / Wi-Fi tuning for MVP-1b ----
# Smaller default LWIP TCP windows — saves ~20KB RAM, fine for a single WS connection.
CONFIG_LWIP_TCP_WND_DEFAULT=4380
CONFIG_LWIP_TCP_SND_BUF_DEFAULT=4380
CONFIG_LWIP_TCP_RECVMBOX_SIZE=6
# mDNS — single interface (STA only). Default in this version of mdns
# component covers more interfaces (eth/sta/ap); narrowing saves a bit.
CONFIG_MDNS_MAX_INTERFACES=1

# ---- LVGL v9 (values must not have inline comments — Kconfig parses them literally) ----
CONFIG_LV_CONF_SKIP=n
# Note: LV_USE_OS isn't surfaced as Kconfig in 9.2 — LVGL's mutex on
# FreeRTOS is opt-in via lv_conf code. Our lvgl_port.c provides its
# own recursive mutex around all lv_*** calls, which is sufficient.
CONFIG_LV_COLOR_DEPTH_16=y
# Heap pool for LVGL widget allocations (KB)
CONFIG_LV_MEM_SIZE_KILOBYTES=48
# Refresh period in ms (20 = 50Hz)
CONFIG_LV_DEF_REFR_PERIOD=20
# Built-in fonts. _14 stays as the LVGL "default" for stock widgets that
# don't take an explicit font (every Doudou label overrides to use the
# custom CJK font in font_cjk/). _20 and _28 were once used for big
# headings, now superseded by the CJK font — dropping them shaves a few
# KB of ROM.
CONFIG_LV_FONT_MONTSERRAT_14=y
CONFIG_LV_FONT_DEFAULT_MONTSERRAT_14=y
# Disable demos to save flash
CONFIG_LV_USE_DEMO_WIDGETS=n
CONFIG_LV_USE_DEMO_BENCHMARK=n
CONFIG_LV_USE_DEMO_STRESS=n
```

## packages/firmware/sdkconfig.defaults.ble
```kconfig
# Doudou — extra sdkconfig defaults to enable BLE GATT transport.
#
# Use:
#   idf.py -DSDKCONFIG_DEFAULTS="sdkconfig.defaults;sdkconfig.defaults.ble" reconfigure
#   idf.py build flash monitor
#
# What it does:
#   * Enables BT controller + NimBLE host
#   * Switches DOUDOU_TRANSPORT to BLE
#   * Disables Wi-Fi-only LWIP knobs that aren't used in BLE mode
#
# Cost:
#   * Adds ~80KB code + ~30KB SRAM (NimBLE stack)
#   * Frees Wi-Fi-related RAM if you also disable Wi-Fi (not done here —
#     net.c is still compiled for now; just unused in BLE transport).

# --- Bluetooth ---
CONFIG_BT_ENABLED=y
CONFIG_BT_CONTROLLER_ENABLED=y
CONFIG_BT_NIMBLE_ENABLED=y
# Peripheral role only (we wait for Bridge to scan + connect).
CONFIG_BT_NIMBLE_ROLE_PERIPHERAL=y
CONFIG_BT_NIMBLE_ROLE_CENTRAL=n
CONFIG_BT_NIMBLE_ROLE_OBSERVER=n
CONFIG_BT_NIMBLE_ROLE_BROADCASTER=n
# One concurrent connection (Bridge only).
CONFIG_BT_NIMBLE_MAX_CONNECTIONS=1
# MTU 247 → ~244B payload per BLE GATT notify, fits our protocol message
# budget in ≤5 fragments.
CONFIG_BT_NIMBLE_ATT_PREFERRED_MTU=247
# Slightly larger task stack — JSON dispatch happens on the host task.
CONFIG_BT_NIMBLE_HOST_TASK_STACK_SIZE=4608
# Bonding storage in NVS — pairing keys survive reboot so re-connect
# doesn't re-pair from scratch. Single Bridge peer; max 1 bond keeps
# storage tiny.
CONFIG_BT_NIMBLE_NVS_PERSIST=y
CONFIG_BT_NIMBLE_MAX_BONDS=1
CONFIG_BT_NIMBLE_MAX_CCCDS=8
# LE Secure Connections (ECDH-based pairing). MITM auth = no (no
# input/output on the device so we run Just Works; pairing happens
# implicitly on first connect, then bond is persisted).
CONFIG_BT_NIMBLE_SM_SC=y
CONFIG_BT_NIMBLE_SM_LEGACY=n

# --- Pick the transport ---
CONFIG_DOUDOU_TRANSPORT_WS=n
CONFIG_DOUDOU_TRANSPORT_BLE=y
```

## packages/firmware/sdkconfig.defaults.wokwi
```kconfig
# Doudou — extra sdkconfig defaults for Wokwi preview.
#
# Use:
#   idf.py -DSDKCONFIG_DEFAULTS="sdkconfig.defaults;sdkconfig.defaults.wokwi" reconfigure
#   idf.py build
#   then run the Wokwi simulator (diagram.json).
#
# What it does:
#   * Flips DOUDOU_LCD_INVERT_COLOR + DOUDOU_LCD_BGR_ORDER off so the
#     ILI9341 model in Wokwi (used as a stand-in for GC9A01) shows the
#     intended colours instead of an inverted BGR negative.
#
# What it does NOT fix:
#   * Wokwi's ILI9341 is 240×320 rectangular; firmware paints only the
#     top 240×240. The bottom 80 lines show uninitialised LCD content.
#     Mentally crop to the top square — the visible UI is correct.
#   * Wi-Fi is a gateway mock and won't reach a real Bridge.
#   * BLE is not modelled at all — this build still uses the default
#     WS transport (set in sdkconfig.defaults).

CONFIG_DOUDOU_LCD_FOR_WOKWI=y
```
